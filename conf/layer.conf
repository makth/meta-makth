## conf/layer.conf
```bitbake
# We have a conf and classes directory, add to BBPATH
BBPATH .= ":${LAYERDIR}"

# We have recipes-* directories, add to BBFILES
BBFILES += "${LAYERDIR}/recipes-*/*/*.bb ${LAYERDIR}/recipes-*/*/*.bbappend"

BBFILE_COLLECTIONS += "makth"
BBFILE_PATTERN_makth = "^${LAYERDIR}/"
BBFILE_PRIORITY_makth = "10"

# This should only be incremented on significant changes that will
# cause compatibility issues with other layers
LAYERVERSION_makth = "1"

LAYERDEPENDS_makth = "core"

LAYERSERIES_COMPAT_makth = "sumo thud warrior zeus"
```
